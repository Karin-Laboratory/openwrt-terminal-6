// SPDX-License-Identifier: GPL-2.0-only
/dts-v1/;
/plugin/;

/*
 * Offline-only SGMII1 PHY consumer wiring.
 * No PLL, SPM or power-domain provider is guessed.
 * Both original nodes remain disabled; not an installable board DT.
 */
/ {
    compatible = "mediatek,mt6990";

    fragment@0 {
        target-path = "/sgmiiphy@11E60000";
        sbat6_phy1: __overlay__ {
            compatible = "mediatek,mt6990-sgmii-phy",
                         "mediatek,colgin-sgmiisys_phy_1", "syscon";
            #phy-cells = <0>;
            mediatek,sgmii-id = <1>;
            status = "disabled";
        };
    };

    fragment@1 {
        target-path = "/sgmiisys@11305000";
        __overlay__ {
            compatible = "mediatek,mt6990-sgmiisys",
                         "mediatek,colgin-sgmiisys_1", "syscon";
            phys = <&sbat6_phy1>;
            phy-names = "sgmii";
            status = "disabled";
        };
    };
};
